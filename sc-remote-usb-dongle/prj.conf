## CMakeLists.txt
```
# SPDX-License-Identifier: Apache-2.0

cmake_minimum_required(VERSION 3.20.0)
find_package(Zephyr REQUIRED HINTS $ENV{ZEPHYR_BASE})
project(hid)

FILE(GLOB app_sources src/*.c)
target_sources(app PRIVATE ${app_sources})
target_include_directories(app PRIVATE include)
```

## prj.conf
```kconfig
CONFIG_USB_DEVICE_STACK=y
CONFIG_USB_DEVICE_HID=y
CONFIG_USB_DEVICE_PRODUCT="Zephyr HID sample"
CONFIG_USB_HID_BOOT_PROTOCOL=y

CONFIG_LOG=y
CONFIG_USB_DRIVER_LOG_LEVEL_ERR=y
CONFIG_USB_DEVICE_LOG_LEVEL_ERR=y

CONFIG_USB_DEVICE_SOF=y
CONFIG_USB_HID_REPORTS=1

CONFIG_DK_LIBRARY=y
```

## src/main.c
```c
/*
 * Copyright (c) 2016-2018 Intel Corporation.
 * Copyright (c) 2018-2021 Nordic Semiconductor ASA
 *
 * SPDX-License-Identifier: Apache-2.0
 */

#include <zephyr.h>

#include "app_usb_hid.h"
#include "app_ble_nus_c_handler.h"
#include "dk_buttons_and_leds.h"

#include <logging/log.h>

#define LOG_LEVEL LOG_LEVEL_INF
LOG_MODULE_REGISTER(main);

#define DK_BUTTON1 0
#define DK_BUTTON2 1
#define DK_BUTTON3 2
#define DK_BUTTON4 3
#define BUTTON_PRESSED(a) ((has_changed & BIT(a)) && (button_state & BIT(a)))
#define BUTTON_RELEASED(a) ((has_changed & BIT(a)) && !(button_state & BIT(a)))

static void app_button_handler(uint32_t button_state, uint32_t has_changed)
{
	if(BUTTON_PRESSED(DK_BUTTON1)) {
		app_usb_hid_send_cons_ctrl_packet(BIT(0));
	}
	if(BUTTON_PRESSED(DK_BUTTON2)) {
		app_usb_hid_send_cons_ctrl_packet(BIT(1));
	}
	if(BUTTON_PRESSED(DK_BUTTON3)) {
		static uint8_t key = KEY_A;
		app_usb_hid_send_kbd_packet(key++, 0);
		if(key > KEY_Z) key = KEY_A;
	} else if(BUTTON_RELEASED(DK_BUTTON3)) {
		app_usb_hid_send_kbd_packet(0, 0);
	}
	if(BUTTON_PRESSED(DK_BUTTON4)) {
		app_usb_hid_send_kbd_packet(KEY_M, HID_KBD_REP_FLAG_LEFT_CTRL | HID_KBD_REP_FLAG_LEFT_SHIFT);
	} else if(BUTTON_RELEASED(DK_BUTTON4)) {
		app_usb_hid_send_kbd_packet(0, 0);
	}
}

void on_nus_client_data_received(uint8_t *data_ptr, uint32_t length)
{
	LOG_INF("Data received: Length %i: %x %x", length, data_ptr[0], data_ptr[1]);
}

void main(void)
{
	int ret;

	LOG_INF("Starting Shortcut Remote Dongle application");

	ret = dk_buttons_init(app_button_handler);
	if(ret != 0) {
		LOG_ERR("Unable to initialize DK buttons!");
	}

	ret = app_usb_hid_init();
	if(ret != 0) {
		LOG_ERR("Unable to initialize USB HID: %d", ret);
	}

	app_ble_nus_c_config_t nus_c_config = {.on_data_received = on_nus_client_data_received};
	ret = app_ble_nus_c_init(&nus_c_config);
	if(ret != 0) {
		LOG_ERR("Unable to initialize BLE Nus client!");
	}
}
```

## include/app_ble_nus_c_handler.h
```c
#ifndef __APP_BLE_NUS_C_HANDLER
#define __APP_BLE_NUS_C_HANDLER

#include <zephyr.h>

typedef void (*app_ble_nus_c_data_received_t)(uint8_t *data_ptr, uint32_t length);

typedef struct {
	app_ble_nus_c_data_received_t on_data_received;
} app_ble_nus_c_config_t;

int app_ble_nus_c_init(app_ble_nus_c_config_t *config);

#endif
```

## include/app_usb_hid.h
```c
#ifndef __APP_USB_HID_H
#define __APP_USB_HID_H

#include <zephyr.h>

#define HID_KBD_REP_FLAG_LEFT_CTRL   BIT(0)
#define HID_KBD_REP_FLAG_LEFT_SHIFT  BIT(1)
#define HID_KBD_REP_FLAG_LEFT_ALT    BIT(2)
#define HID_KBD_REP_FLAG_LEFT_GUI    BIT(3)
#define HID_KBD_REP_FLAG_RIGHT_CTRL  BIT(4)
#define HID_KBD_REP_FLAG_RIGHT_SHIFT BIT(5)
#define HID_KBD_REP_FLAG_RIGHT_ALT   BIT(6)
#define HID_KBD_REP_FLAG_RIGHT_GUI   BIT(7)

enum {KEY_A=0x4, KEY_B, KEY_C, KEY_D, KEY_E, KEY_F, KEY_G, KEY_H, KEY_I, KEY_J, KEY_K, KEY_L, KEY_M, KEY_N, KEY_O, KEY_P, KEY_Q, KEY_R, KEY_S, KEY_T, KEY_U, KEY_V, KEY_W, KEY_X, KEY_Y, KEY_Z,
		KEY_1=0x1E, KEY_2, KEY_3, KEY_4, KEY_5, KEY_6, KEY_7, KEY_8, KEY_9, KEY_0, 
		KEY_ENTER=0x28, KEY_ESC, KEY_DELETE, KEY_TAB, KEY_SPACE, KEY_DASH, KEY_EQUAL, 
		KEY_F1=0x3A, KEY_F2, KEY_F3, KEY_F4, KEY_F5, KEY_F6, KEY_F7, KEY_F8, KEY_F9, KEY_F10, KEY_F11, KEY_F12, 
		KEY_PRINTSCREEN=0x46, KEY_SCROLL_LOCK, KEY_PAUSE, KEY_INSERT, KEY_HOME, KEY_PAGE_UP, KEY_DEL_FORWARD, KEY_END, KEY_PAGE_DOWN, KEY_ARROW_RIGHT, KEY_ARROW_LEFT, KEY_ARROW_DOWN, KEY_ARROW_UP,
		KEY_KPAD_NUM_LOCK=0x53, KEY_KPAD_DIVIDE, KEY_KPAD_MULTIPLY, KEY_KPAD_MINUS, KEY_KPAD_PLUS, KEY_KPAD_ENTER, KEY_KPAD_1, KEY_KPAD_2, KEY_KPAD_3, KEY_KPAD_4, KEY_KPAD_5, KEY_KPAD_6, KEY_KPAD_7, KEY_KPAD_8, KEY_KPAD_9, KEY_KPAD_0, KEY_KPAD_DOT};

int app_usb_hid_init(void);

int app_usb_hid_send_kbd_packet(uint8_t key1, uint8_t flags);

int app_usb_hid_send_cons_ctrl_packet(uint8_t cons_ctrl_bitfield);

#endif
```

## src/app_ble_nus_c_handler.c
```c
/*
 * Copyright (c) 2018 Nordic Semiconductor ASA
 *
 * SPDX-License-Identifier: LicenseRef-Nordic-5-Clause
 */

/** @file
 *  @brief Nordic UART Service Client sample
 */

#include "app_ble_nus_c_handler.h"
#include <errno.h>
#include <zephyr.h>
#include <sys/byteorder.h>
#include <sys/printk.h>

#include <bluetooth/bluetooth.h>
#include <bluetooth/hci.h>
#include <bluetooth/conn.h>
#include <bluetooth/uuid.h>
#include <bluetooth/gatt.h>

#include <bluetooth/services/nus.h>
#include <bluetooth/services/nus_client.h>
#include <bluetooth/gatt_dm.h>
#include <bluetooth/scan.h>

#include <settings/settings.h>

#include <logging/log.h>

#define LOG_MODULE_NAME app_ble_nus_c_handler
LOG_MODULE_REGISTER(LOG_MODULE_NAME);

// Random 128-bit UUID generated from www.uuidgenerator.net/version4
#define BT_UUID_SC_REMOTE_SERVICE BT_UUID_DECLARE_128(BT_UUID_128_ENCODE(0x988f9c8d, 0x2b03, 0x489f, 0xa102, 0x4d83463b90f3))

/* UART payload buffer element size. */
#define UART_BUF_SIZE 20

#define KEY_PASSKEY_ACCEPT DK_BTN1_MSK
#define KEY_PASSKEY_REJECT DK_BTN2_MSK

#define NUS_WRITE_TIMEOUT K_MSEC(150)
#define UART_WAIT_FOR_BUF_DELAY K_MSEC(50)
#define UART_RX_TIMEOUT 50

static struct bt_conn *default_conn;
static struct bt_nus_client nus_client;

static app_ble_nus_c_data_received_t m_data_received_callback;

static void ble_data_sent(struct bt_nus_client *nus, uint8_t err,
					const uint8_t *const data, uint16_t len)
{

}

static uint8_t ble_data_received(struct bt_nus_client *nus,
						const uint8_t *data, uint16_t len)
{
	if(m_data_received_callback) {
		m_data_received_callback(data, len);
	}
	return BT_GATT_ITER_CONTINUE;
}

static void discovery_complete(struct bt_gatt_dm *dm,
			       void *context)
{
	struct bt_nus_client *nus = context;
	LOG_INF("Service discovery completed");

	bt_gatt_dm_data_print(dm);

	bt_nus_handles_assign(dm, nus);
	bt_nus_subscribe_receive(nus);

	bt_gatt_dm_data_release(dm);
}

static void discovery_service_not_found(struct bt_conn *conn,
					void *context)
{
	LOG_INF("Service not found");
}

static void discovery_error(struct bt_conn *conn,
			    int err,
			    void *context)
{
	LOG_WRN("Error while discovering GATT database: (%d)", err);
}

struct bt_gatt_dm_cb discovery_cb = {
	.completed         = discovery_complete,
	.service_not_found = discovery_service_not_found,
	.error_found       = discovery_error,
};

static void gatt_discover(struct bt_conn *conn)
{
	int err;

	if (conn != default_conn) {
		return;
	}

	err = bt_gatt_dm_start(conn,
			       BT_UUID_NUS_SERVICE,
			       &discovery_cb,
			       &nus_client);
	if (err) {
		LOG_ERR("could not start the discovery procedure, error "
			"code: %d", err);
	}
}

static void exchange_func(struct bt_conn *conn, uint8_t err, struct bt_gatt_exchange_params *params)
{
	if (!err) {
		LOG_INF("MTU exchange done");
	} else {
		LOG_WRN("MTU exchange failed (err %" PRIu8 ")", err);
	}
}

static void connected(struct bt_conn *conn, uint8_t conn_err)
{
	char addr[BT_ADDR_LE_STR_LEN];
	int err;

	bt_addr_le_to_str(bt_conn_get_dst(conn), addr, sizeof(addr));

	if (conn_err) {
		LOG_INF("Failed to connect to %s (%d)", log_strdup(addr),
			conn_err);

		if (default_conn == conn) {
			bt_conn_unref(default_conn);
			default_conn = NULL;

			err = bt_scan_start(BT_SCAN_TYPE_SCAN_ACTIVE);
			if (err) {
				LOG_ERR("Scanning failed to start (err %d)",
					err);
			}
		}

		return;
	}

	LOG_INF("Connected: %s", log_strdup(addr));

	static struct bt_gatt_exchange_params exchange_params;

	exchange_params.func = exchange_func;
	err = bt_gatt_exchange_mtu(conn, &exchange_params);
	if (err) {
		LOG_WRN("MTU exchange failed (err %d)", err);
	}

	err = bt_conn_set_security(conn, BT_SECURITY_L2);
	if (err) {
		LOG_WRN("Failed to set security: %d", err);

		gatt_discover(conn);
	}

	err = bt_scan_stop();
	if ((!err) && (err != -EALREADY)) {
		LOG_ERR("Stop LE scan failed (err %d)", err);
	}
}

static void disconnected(struct bt_conn *conn, uint8_t reason)
{
	char addr[BT_ADDR_LE_STR_LEN];
	int err;

	bt_addr_le_to_str(bt_conn_get_dst(conn), addr, sizeof(addr));

	LOG_INF("Disconnected: %s (reason %u)", log_strdup(addr),
		reason);

	if (default_conn != conn) {
		return;
	}

	bt_conn_unref(default_conn);
	default_conn = NULL;

	err = bt_scan_start(BT_SCAN_TYPE_SCAN_ACTIVE);
	if (err) {
		LOG_ERR("Scanning failed to start (err %d)",
			err);
	}
}

static void security_changed(struct bt_conn *conn, bt_security_t level,
			     enum bt_security_err err)
{
	char addr[BT_ADDR_LE_STR_LEN];

	bt_addr_le_to_str(bt_conn_get_dst(conn), addr, sizeof(addr));

	if (!err) {
		LOG_INF("Security changed: %s level %u", log_strdup(addr),
			level);
	} else {
		LOG_WRN("Security failed: %s level %u err %d", log_strdup(addr),
			level, err);
	}

	gatt_discover(conn);
}

static struct bt_conn_cb conn_callbacks = {
	.connected = connected,
	.disconnected = disconnected,
	.security_changed = security_changed
};

static void scan_filter_match(struct bt_scan_device_info *device_info,
			      struct bt_scan_filter_match *filter_match,
			      bool connectable)
{
	char addr[BT_ADDR_LE_STR_LEN];

	bt_addr_le_to_str(device_info->recv_info->addr, addr, sizeof(addr));

	LOG_INF("Filters matched. Address: %s connectable: %d",
		log_strdup(addr), connectable);
}

static void scan_connecting_error(struct bt_scan_device_info *device_info)
{
	LOG_WRN("Connecting failed");
}

static void scan_connecting(struct bt_scan_device_info *device_info,
			    struct bt_conn *conn)
{
	default_conn = bt_conn_ref(conn);
}

static int nus_client_init(void)
{
	int err;
	struct bt_nus_client_init_param init = {
		.cb = {
			.received = ble_data_received,
			.sent = ble_data_sent,
		}
	};

	err = bt_nus_client_init(&nus_client, &init);
	if (err) {
		LOG_ERR("NUS Client initialization failed (err %d)", err);
		return err;
	}

	LOG_INF("NUS Client module initialized");
	return err;
}

BT_SCAN_CB_INIT(scan_cb, scan_filter_match, NULL,
		scan_connecting_error, scan_connecting);

static int scan_init(void)
{
	int err;
	struct bt_scan_init_param scan_init = {
		.connect_if_match = 1,
	};

	bt_scan_init(&scan_init);
	bt_scan_cb_register(&scan_cb);

	err = bt_scan_filter_add(BT_SCAN_FILTER_TYPE_UUID, BT_UUID_SC_REMOTE_SERVICE);
	if (err) {
		LOG_ERR("Scanning filters cannot be set (err %d)", err);
		return err;
	}

	err = bt_scan_filter_enable(BT_SCAN_UUID_FILTER, false);
	if (err) {
		LOG_ERR("Filters cannot be turned on (err %d)", err);
		return err;
	}

	LOG_INF("Scan module initialized");
	return err;
}


static void auth_cancel(struct bt_conn *conn)
{
	char addr[BT_ADDR_LE_STR_LEN];

	bt_addr_le_to_str(bt_conn_get_dst(conn), addr, sizeof(addr));

	LOG_INF("Pairing cancelled: %s", log_strdup(addr));
}


static void pairing_complete(struct bt_conn *conn, bool bonded)
{
	char addr[BT_ADDR_LE_STR_LEN];

	bt_addr_le_to_str(bt_conn_get_dst(conn), addr, sizeof(addr));

	LOG_INF("Pairing completed: %s, bonded: %d", log_strdup(addr),
		bonded);
}


static void pairing_failed(struct bt_conn *conn, enum bt_security_err reason)
{
	char addr[BT_ADDR_LE_STR_LEN];

	bt_addr_le_to_str(bt_conn_get_dst(conn), addr, sizeof(addr));

	LOG_WRN("Pairing failed conn: %s, reason %d", log_strdup(addr),
		reason);
}

static struct bt_conn_auth_cb conn_auth_callbacks = {
	.cancel = auth_cancel,
	.pairing_complete = pairing_complete,
	.pairing_failed = pairing_failed
};

int app_ble_nus_c_init(app_ble_nus_c_config_t *config)
{
	int err;

	m_data_received_callback = config->on_data_received;

	err = bt_conn_auth_cb_register(&conn_auth_callbacks);
	if (err) {
		LOG_ERR("Failed to register authorization callbacks.");
		return err;
	}

	err = bt_enable(NULL);
	if (err) {
		LOG_ERR("Bluetooth init failed (err %d)", err);
		return err;
	}
	LOG_INF("Bluetooth initialized");

	if (IS_ENABLED(CONFIG_SETTINGS)) {
		settings_load();
	}

	bt_conn_cb_register(&conn_callbacks);

	int (*module_init[])(void) = {scan_init, nus_client_init};
	for (size_t i = 0; i < ARRAY_SIZE(module_init); i++) {
		err = (*module_init[i])();
		if (err) {
			return err;
		}
	}

	printk("Starting Bluetooth Central UART example\n");


	err = bt_scan_start(BT_SCAN_TYPE_SCAN_ACTIVE);
	if (err) {
		LOG_ERR("Scanning failed to start (err %d)", err);
		return err;
	}

	LOG_INF("Scanning successfully started");

	return 0;
}
```

## src/app_usb_hid.c
```c
#include "app_usb_hid.h"

#include <init.h>

#include <usb/usb_device.h>
#include <usb/class/usb_hid.h>

#include <logging/log.h>

#define LOG_LEVEL LOG_LEVEL_INF
LOG_MODULE_REGISTER(app_usb_hid);

#define HID_KBD_USAGE_CONS_CTRL_POWER				0x09, 0x30
#define HID_KBD_USAGE_CONS_CTRL_RESET				0x09, 0x31
#define HID_KBD_USAGE_CONS_CTRL_SLEEP				0x09, 0x32
#define HID_KBD_USAGE_CONS_CTRL_SCAN_NEXT_TRACK 	0x09, 0xB5
#define HID_KBD_USAGE_CONS_CTRL_SCAN_PREV_TRACK 	0x09, 0xB6
#define HID_KBD_USAGE_CONS_CTRL_PLAY_PAUSE 			0x09, 0xCD
#define HID_KBD_USAGE_CONS_CTRL_MUTE	 			0x09, 0xE2
#define HID_KBD_USAGE_CONS_CTRL_VOLUME_UP			0x09, 0xE9
#define HID_KBD_USAGE_CONS_CTRL_VOLUME_DOWN 		0x09, 0xEA
#define HID_KBD_USAGE_CONS_CTRL_AC_BACK				0x0A, 0x24, 0x02,  
#define HID_KBD_USAGE_CONS_CTRL_AC_FORWARD			0x0A, 0x25, 0x02,  

static bool configured;
static const struct device *hdev;
static ATOMIC_DEFINE(hid_ep_in_busy, 1);

#define HID_EP_BUSY_FLAG		0

#define REPORT_ID_KBD			0x01
#define REPORT_ID_CONS_CTRL		0x02
#define REPORT_SIZE_KBD			9
#define REPORT_SIZE_CONS_CTRL	2

#define REPORT_PERIOD		K_SECONDS(2)

struct report {
	uint8_t report_id;
	union {
		struct {
			uint8_t flags;
			uint8_t padding;
			uint8_t keys[6];
		} kbd;
		struct {
			uint8_t button_bitfield;
		} cons_ctrl;
	} data;
};

// Create a message queue for holding HID packets. 
K_MSGQ_DEFINE(m_hid_msg_queue, sizeof(struct report), 10, 4);

static const uint8_t hid_report_desc[] = {
		0x05, 0x01,       /* Usage Page (Generic Desktop) */
		0x09, 0x06,       /* Usage (Keyboard) */
		0xA1, 0x01,       /* Collection (Application) */

		0x85, REPORT_ID_KBD, /* Report ID 1 */
		/* Keys */
		0x05, 0x07,       /* Usage Page (Key Codes) */
		0x19, 0xe0,       /* Usage Minimum (224) */
		0x29, 0xe7,       /* Usage Maximum (231) */
		0x15, 0x00,       /* Logical Minimum (0) */
		0x25, 0x01,       /* Logical Maximum (1) */
		0x75, 0x01,       /* Report Size (1) */
		0x95, 0x08,       /* Report Count (8) */
		0x81, 0x02,       /* Input (Data, Variable, Absolute) */

		0x95, 0x01,       /* Report Count (1) */
		0x75, 0x08,       /* Report Size (8) */
		0x81, 0x01,       /* Input (Constant) reserved byte(1) */

		0x95, 0x06,       /* Report Count (6) */
		0x75, 0x08,       /* Report Size (8) */
		0x15, 0x00,       /* Logical Minimum (0) */
		0x25, 0x65,       /* Logical Maximum (101) */
		0x05, 0x07,       /* Usage Page (Key codes) */
		0x19, 0x00,       /* Usage Minimum (0) */
		0x29, 0x65,       /* Usage Maximum (101) */
		0x81, 0x00,       /* Input (Data, Array) Key array(6 bytes) */

		0xC0,             /* End Collection (Application) */

		        // Report ID 2: Advanced buttons (consumer control)
        0x05, 0x0C,                     // Usage Page (Consumer)
        0x09, 0x01,                     // Usage (Consumer Control)
        0xA1, 0x01,                     // Collection (Application)
        0x85, REPORT_ID_CONS_CTRL,      //     Report Id (2)
        0x15, 0x00,                     //     Logical minimum (0)
        0x25, 0x01,                     //     Logical maximum (1)
        0x75, 0x01,                     //     Report Size (1)
        0x95, 0x01,                     //     Report Count (1)

        HID_KBD_USAGE_CONS_CTRL_VOLUME_UP,
        0x81, 0x02,                     //     Input (Data,Value,Relative,Bit Field)
        HID_KBD_USAGE_CONS_CTRL_VOLUME_DOWN,
        0x81, 0x02,                     //     Input (Data,Value,Relative,Bit Field)
        HID_KBD_USAGE_CONS_CTRL_PLAY_PAUSE,
        0x81, 0x02,                     //     Input (Data,Value,Relative,Bit Field)
        HID_KBD_USAGE_CONS_CTRL_MUTE,
        0x81, 0x02,                     //     Input (Data,Value,Relative,Bit Field)

        HID_KBD_USAGE_CONS_CTRL_SCAN_NEXT_TRACK,
        0x81, 0x02,                     //     Input (Data,Value,Relative,Bit Field)
        HID_KBD_USAGE_CONS_CTRL_SCAN_PREV_TRACK,
        0x81, 0x02,                     //     Input (Data,Value,Relative,Bit Field)
        HID_KBD_USAGE_CONS_CTRL_POWER,
        0x81, 0x02,                     //     Input (Data,Value,Relative,Bit Field)
        HID_KBD_USAGE_CONS_CTRL_SLEEP,
        0x81, 0x02,                     //     Input (Data,Value,Relative,Bit Field)
        0xC0                            // End Collection
};

static void send_report(struct report *hid_report)
{
	int ret, wrote;
	uint32_t size;

	// Set the size of the report according to the report ID
	switch(hid_report->report_id) {
		case REPORT_ID_KBD:
			size = REPORT_SIZE_KBD;
			break;
		case REPORT_ID_CONS_CTRL:
			size = REPORT_SIZE_CONS_CTRL;
			break;
		default:
			return;
	}

	// Send the packet over the HID endpoint, assuming it is not busy
	if (!atomic_test_and_set_bit(hid_ep_in_busy, HID_EP_BUSY_FLAG)) {
		ret = hid_int_ep_write(hdev, (uint8_t *)hid_report, size, &wrote);
		if (ret != 0) {
			/*
			 * Do nothing and wait until host has reset the device
			 * and hid_ep_in_busy is cleared.
			 */
			LOG_ERR("Failed to submit report");
		} else {
			LOG_DBG("Report submitted");
		}
	} else {
		LOG_DBG("HID IN endpoint busy");
	}
}

static void int_in_ready_cb(const struct device *dev)
{
	ARG_UNUSED(dev);
	if (!atomic_test_and_clear_bit(hid_ep_in_busy, HID_EP_BUSY_FLAG)) {
		LOG_WRN("IN endpoint callback without preceding buffer write");
	}
}

/*
 * On Idle callback is available here as an example even if actual use is
 * very limited. In contrast to report_event_handler(),
 * report value is not incremented here.
 */
static void on_idle_cb(const struct device *dev, uint16_t report_id)
{
	LOG_DBG("On idle callback");
}

static void protocol_cb(const struct device *dev, uint8_t protocol)
{
	LOG_INF("New protocol: %s", protocol == HID_PROTOCOL_BOOT ?
		"boot" : "report");
}

static const struct hid_ops ops = {
	.int_in_ready = int_in_ready_cb,
	.on_idle = on_idle_cb,
	.protocol_change = protocol_cb,
};

static void status_cb(enum usb_dc_status_code status, const uint8_t *param)
{
	switch (status) {
	case USB_DC_RESET:
		configured = false;
		break;
	case USB_DC_CONFIGURED:
		if (!configured) {
			int_in_ready_cb(hdev);
			configured = true;
		}
		break;
	case USB_DC_SOF:
		break;
	default:
		LOG_DBG("status %u unhandled", status);
		break;
	}
}

// HID TX thread function. Used to send HID packets over USB. 
void usb_hid_tx_func(void)
{
	static struct report new_report;
	while(1) {
		// Wait until there is a new message in the queue, and read it out
		k_msgq_get(&m_hid_msg_queue, &new_report, K_FOREVER);

		// Send the new report over the HID interface
		send_report(&new_report);
	}
}

int app_usb_hid_init(void)
{
	int ret;

	LOG_INF("Initializing app_usb_hid");

	ret = usb_enable(status_cb);
	if (ret != 0) {
		LOG_ERR("Failed to enable USB");
		return ret;
	}

	return 0;
}

static int composite_pre_init(const struct device *dev)
{
	hdev = device_get_binding("HID_0");
	if (hdev == NULL) {
		LOG_ERR("Cannot get USB HID Device");
		return -ENODEV;
	}

	LOG_INF("HID Device: dev %p", hdev);

	usb_hid_register_device(hdev, hid_report_desc, sizeof(hid_report_desc),
				&ops);

	atomic_set_bit(hid_ep_in_busy, HID_EP_BUSY_FLAG);

	if (usb_hid_set_proto_code(hdev, HID_BOOT_IFACE_CODE_NONE)) {
		LOG_WRN("Failed to set Protocol Code");
	}

	return usb_hid_init(hdev);
}

int app_usb_hid_send_kbd_packet(uint8_t key1, uint8_t flags)
{
	int ret;
	static struct report kbd_report 
		= {.report_id = REPORT_ID_KBD, .data.kbd.keys = {0,0,0,0,0,0}};
	kbd_report.data.kbd.keys[0] = key1;
	kbd_report.data.kbd.flags = flags;
	ret = k_msgq_put(&m_hid_msg_queue, &kbd_report, K_NO_WAIT);
	return ret;
}

int app_usb_hid_send_cons_ctrl_packet(uint8_t cons_ctrl_bitfield)
{
	int ret;
	static struct report cons_ctrl_report = {.report_id = REPORT_ID_CONS_CTRL};
	cons_ctrl_report.data.cons_ctrl.button_bitfield = cons_ctrl_bitfield;
	ret = k_msgq_put(&m_hid_msg_queue, &cons_ctrl_report, K_NO_WAIT);
	return ret;
}

// Create a thread for sending HID messages to the USB stack. 
K_THREAD_DEFINE(m_thread_usb_hid_tx, 1024, usb_hid_tx_func, NULL, NULL, NULL, 5, 0, 0);

SYS_INIT(composite_pre_init, APPLICATION, CONFIG_KERNEL_INIT_PRIORITY_DEVICE);
```
